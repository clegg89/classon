## build/conf/bblayers.conf
```bitbake
LCONF_VERSION = "6"  
  
BBPATH = "${TOPDIR}"  
BSPDIR := "${@os.path.abspath(os.path.dirname(d.getVar('FILE', True)) + '/../..')}"  
  
BBFILES ?= ""  
BBLAYERS = " \  
  ${BSPDIR}/repo-deps/openembedded-core/meta \  
  ${BSPDIR}/repo-deps/meta-fsl-arm \
  ${BSPDIR}/repo-deps/meta-solidrun-arm-imx6 \  
  ${BSPDIR}/meta-classon \  
  ${BSPDIR}/repo-deps/meta-yocto/meta-yocto \
  ${BSPDIR}/repo-deps/meta-yocto/meta-yocto-bsp \  
  ${BSPDIR}/repo-deps/meta-openembedded/meta-oe \  
  ${BSPDIR}/repo-deps/meta-openembedded/meta-multimedia \  
"

BBLAYERS_NON_REMOVABLE ?= " \
  ${BSPDIR}/repo-deps/openembedded-core/meta \
  ${BSPDIR}/repo-deps/meta-yocto/meta-yocto \
  "
```

## meta-classon/conf/distro/classondist.conf
```bitbake
require conf/distro/poky.conf      
# distro name  
DISTRO = "classondist"      
DISTRO_NAME = "classon distribution"      
DISTRO_VERSION = "1.0"      
DISTRO_CODENAME = "clsn"      
DISTRO_FEATURES_append = " alsa usbhost usbgadget keyboard bluetooth pci wifi serial"  
SDK_VENDOR = "-classondistsdk"      
SDK_VERSION := "${@'${DISTRO_VERSION}'.replace('snapshot-${DATE}','snapshot')}"      
MAINTAINER = "classondist "      
INHERIT += "buildhistory"      
BUILDHISTORY_COMMIT = "1"
```

## meta-classon/conf/layer.conf
```bitbake
BBPATH .= ":${LAYERDIR}"    
BBFILES += "${LAYERDIR}/recipes-*/*/*.bb \   
    ${LAYERDIR}/recipes-*/*/*.bbappend"    
BBFILE_COLLECTIONS += "classon"    
BBFILE_PATTERN_classon = "^${LAYERDIR}/"    
BBFILE_PRIORITY_classon = "7" 
```
